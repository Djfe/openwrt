// SPDX-License-Identifier: GPL-2.0-or-later OR MIT

#include "mt7621_cudy_wr1300.dtsi"

/ {
	compatible = "cudy,wr1300-v1", "mediatek,mt7621-soc";
	model = "Cudy WR1300 v1";

	leds {
		usb {
			label = "green:usb";
			gpios = <&gpio 14 GPIO_ACTIVE_HIGH>;
			trigger-sources = <&xhci_ehci_port1>, <&ehci_port2>;
			linux,default-trigger = "usbport";
		};
	};
};
